## boards/arm/ibakey54/Kconfig.board
```kconfig
# Ibakey54 board configuration

# Copyright (c) 2024 The ZMK Contributors
# SPDX-License-Identifier: MIT

config SHIELD_IBAKEY54_LEFT
    def_bool ${shield_list_contains,ibakey54_left}
    depends on SOC_NRF52840_QIAA

config SHIELD_IBAKEY54_RIGHT
    def_bool ${shield_list_contains,ibakey54_right}
    depends on SOC_NRF52840_QIAA
```

## boards/arm/ibakey54/Kconfig.defconfig
```kconfig
if SHIELD_IBAKEY54_LEFT

config ZMK_KEYBOARD_NAME
    default "ibakey54"
    
config ZMK_SPLIT_ROLE_CENTRAL
    default y

endif

if SHIELD_IBAKEY54_LEFT || SHIELD_IBAKEY54_RIGHT

config ZMK_SPLIT
    default y

endif
```

## boards/shields/ibakey52/Kconfig.defconfig
```kconfig
# Copyright (c) 2024 The ZMK Contributors
# SPDX-License-Identifier: MIT

if SHIELD_IBAKEY52_LEFT

config ZMK_KEYBOARD_NAME
    default "ibakey52"
    
config ZMK_SPLIT_ROLE_CENTRAL
    default y

endif

if SHIELD_IBAKEY52_LEFT || SHIELD_IBAKEY52_RIGHT

config ZMK_SPLIT
    default y

endif   # SHIELD_IBAKEY52_LEFT
```

## boards/shields/ibakey52/Kconfig.shield
```kconfig
# Ibakey52 shield configuration

# Copyright (c) 2024 The ZMK Contributors
# SPDX-License-Identifier: MIT

config SHIELD_IBAKEY52_LEFT
    def_bool $(shields_list_contains,ibakey52_left)

config SHIELD_IBAKEY52_RIGHT
    def_bool $(shields_list_contains,ibakey52_right)
```
